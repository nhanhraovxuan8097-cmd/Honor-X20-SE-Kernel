## Code_Opensource/kernel/drivers/huawei_platform/hw_kstate/Kconfig
```kconfig
config KSTATE
    tristate "Kernel State"
    help
        kernel state, please choose it.
```

## Code_Opensource/kernel/drivers/huawei_platform/power/Kconfig
```kconfig
source "drivers/huawei_platform/power/charger/Kconfig"
source "drivers/huawei_platform/power/uscp/Kconfig"
source "drivers/huawei_platform/power/pid_socket/Kconfig"
source "drivers/huawei_platform/power/wireless/Kconfig"
source "drivers/huawei_platform/power/hardware_ic/Kconfig"
source "drivers/huawei_platform/power/common_module/Kconfig"
source "drivers/huawei_platform/power/battery/Kconfig"
source "drivers/huawei_platform/power/proxy/Kconfig"
source "drivers/huawei_platform/power/dubai/Kconfig"
```

## Code_Opensource/kernel/drivers/huawei_platform/power/battery/Kconfig
```kconfig
source "drivers/huawei_platform/power/battery/battery_ct/Kconfig"
source "drivers/huawei_platform/power/battery/battery_type_identify/Kconfig"
```

## Code_Opensource/kernel/drivers/huawei_platform/power/hardware_ic/fuel_gauge/Kconfig
```kconfig
#
# fuel gauge ic drivers
#
source "drivers/huawei_platform/power/hardware_ic/fuel_gauge/rt9426/Kconfig"
source "drivers/huawei_platform/power/hardware_ic/fuel_gauge/bq27z561/Kconfig"

config FUEL_GAUGE
	bool "fuel gauge"
	default n
	help
	  Say Y here to enable fuel gauge.
	  this driver provides a unified interface to the coul.
	  Currently supported coul as below.
	  bq27z561
	  rt9426
```

## Code_Opensource/kernel/drivers/huawei_platform/power/hardware_ic/fuel_gauge/bq27z561/Kconfig
```kconfig
config BQ27Z561_FUEL_GAUGE
	bool "bq27z561 fuel gauge"
	depends on FUEL_GAUGE
	default n
	help
	  Say Y here to enable bq27z561 fuel gauge driver.
	  this driver provides some interfaces to the coul.
	  also support a few high accuracy battery elements.
	  for example current and voltage.
```

## Code_Opensource/kernel/drivers/huawei_platform/power/hardware_ic/wireless_charge_ic/Kconfig
```kconfig
#
# wireless charge ic driver
#

config WIRELESS_STWLC68
	bool "wireless stwlc68"
	depends on WIRELESS_CHARGER
	default n
	help
	  Say Y here to enable stwlc88 driver.
	  The stwlc68 is an soc for magnetic induction
	  based wireless power receiver. it is fully compliant
	  with latest WPC Qi specification of BPP and EPP
	  and also supports various proprietary fast charging
	  protocols used by major smart phone OEM.
```

## Code_Opensource/kernel/drivers/huawei_platform/power/uscp/Kconfig
```kconfig
config HUAWEI_USB_SHORT_CIRCUIT_PROTECT
	bool "huawei usb short circuit protect"
	default n

config MT6873_USCP_ADC
	bool "mt6873_uscp_adc"
	default n
```

## Code_Opensource/kernel/drivers/huawei_platform/usb/pd/Kconfig
```kconfig
config HUAWEI_PD
        bool "huawei_pd"
        default n

source "drivers/huawei_platform/usb/pd/fusb302b/Kconfig"
```

## Code_Opensource/kernel/drivers/hwpower/cc_hardware_ic/fuel_gauge/Kconfig
```kconfig
#
# fuel gauge ic drivers
#

config CW2217_FUEL_GAUGE
	bool "cw2217 fuel gauge"
	depends on FUEL_GAUGE
	default n
	help
	  Say Y here to enable cw2217 fuel gauge driver.
	  this driver provides some interfaces to the coul.
	  also support a few high accuracy battery elements.
	  for example current and voltage.

config RT9426A_FUEL_GAUGE
	bool "rt9426 fuel gauge"
	depends on FUEL_GAUGE
	default n
	help
	  Say Y here to enable rt9426a fuel gauge driver.
	  this driver provides some interfaces to the coul.
	  also support a few high accuracy battery elements.
	  for example current and voltage.
```

## Code_Opensource/kernel/drivers/hwpower/cc_isolation/Kconfig
```kconfig
#
# huawei power isolation drivers
#

config HUAWEI_POWER_EMBEDDED_ISOLATION
	bool "huawei power isolation module"
	default n
	help
	  Say Y here to enable power isolation driver.

config HONOR_POWER_EMBEDDED_ISOLATION
	bool " power isolation module"
	default n
	help
	  Say Y here to enable power isolation driver.
```

## Code_Opensource/kernel/drivers/hwpower/cc_wireless/Kconfig
```kconfig
#
# huawei wireless drivers
#

source "drivers/hwpower/cc_wireless/wireless_firmware/Kconfig"
```

## Code_Opensource/kernel/drivers/hwpower/cc_wireless/wireless_firmware/Kconfig
```kconfig
#
# huawei wireless firmware drivers
#

config WIRELESS_FIRMWARE
	bool "wireless firmware"
	default n
	help
	  Say Y here to enable wireless firmware driver.
```
