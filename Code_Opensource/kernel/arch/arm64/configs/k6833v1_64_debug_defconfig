## Code_Opensource/kernel/arch/arm64/configs/k6833v1_64_debug_defconfig
```kconfig
CONFIG_CROSS_COMPILE="aarch64-linux-android-"
# CONFIG_LOCALVERSION_AUTO is not set
# CONFIG_FHANDLE is not set
CONFIG_IKHEADERS=m
CONFIG_LOG_BUF_SHIFT=20
CONFIG_UCLAMP_TASK=y
CONFIG_UCLAMP_GROUPS_COUNT=32
CONFIG_UCLAMP_MAP_OPP=y
CONFIG_NONLINEAR_FREQ_CTL=y
CONFIG_BLK_CGROUP=y
CONFIG_UCLAMP_TASK_GROUP=y
CONFIG_CPUSETS=y
CONFIG_CGROUP_DEBUG=y
CONFIG_SCHED_TUNE=y
CONFIG_DEFAULT_USE_ENERGY_AWARE=y
CONFIG_SYSCTL_SYSCALL=y
# CONFIG_KALLSYMS_BASE_RELATIVE is not set
CONFIG_CC_STACKPROTECTOR_STRONG=y
CONFIG_LTO_CLANG=y
CONFIG_CFI_CLANG=y
CONFIG_MODULE_SRCVERSION_ALL=y
# CONFIG_BLK_DEV_BSG is not set
CONFIG_BLK_INLINE_ENCRYPTION=y
CONFIG_BLK_INLINE_ENCRYPTION_FALLBACK=y
CONFIG_MACH_MT6833=y
CONFIG_SCHED_MC=y
CONFIG_NR_CPUS=8
CONFIG_PREEMPT=y
CONFIG_HYPERHOLD=y
CONFIG_HYPERHOLD_FILE_LRU=y
CONFIG_HYPERHOLD_ZSWAPD=y
CONFIG_HYPERHOLD_DEBUG=y
# CONFIG_BOUNCE is not set
CONFIG_ZSMALLOC=y
CONFIG_ZS_MALLOC_EXT=y
CONFIG_RANDOMIZE_BASE=y
CONFIG_CMDLINE="console=tty0 console=ttyMT3,921600n1 root=/dev/ram vmalloc=496M slub_max_order=0 slub_debug=O "
# CONFIG_EFI is not set
CONFIG_BUILD_ARM64_APPENDED_DTB_IMAGE=y
CONFIG_BUILD_ARM64_APPENDED_DTB_IMAGE_NAMES="mediatek/mt6833"
# CONFIG_CORE_DUMP_DEFAULT_ELF_HEADERS is not set
CONFIG_COMPAT=y
CONFIG_PM_DEBUG=y
CONFIG_DPM_WATCHDOG=y
CONFIG_DPM_WATCHDOG_TIMEOUT=10
CONFIG_WQ_POWER_EFFICIENT_DEFAULT=y
CONFIG_CPU_FREQ=y
CONFIG_CPU_FREQ_STAT=y
CONFIG_CPU_FREQ_DEFAULT_GOV_SCHEDUTIL=y
CONFIG_CPU_FREQ_GOV_POWERSAVE=y
CONFIG_CPU_FREQ_GOV_USERSPACE=y
CONFIG_CPU_FREQ_GOV_ONDEMAND=y
CONFIG_XFRM_MIGRATE=y
CONFIG_SYN_COOKIES=y
CONFIG_BRIDGE=y
CONFIG_VLAN_8021Q=y
CONFIG_CLS_U32_PERF=y
CONFIG_CLS_U32_MARK=y
CONFIG_CFG80211=y
CONFIG_NL80211_TESTMODE=y
CONFIG_CFG80211_DEVELOPER_WARNINGS=y
# CONFIG_CFG80211_DEFAULT_PS is not set
CONFIG_CFG80211_DEBUGFS=y
CONFIG_CFG80211_INTERNAL_REGDB=y
CONFIG_MTK_NET_LOGGING=y
# CONFIG_UEVENT_HELPER is not set
CONFIG_EXTRA_FIRMWARE="valhall-1691526.wa"
CONFIG_EXTRA_FIRMWARE_DIR="firmware"
CONFIG_MTD=y
CONFIG_MTD_BLOCK=y
CONFIG_HW_VIP_THREAD=y
CONFIG_HW_QOS_THREAD=y
CONFIG_VIP_PREFER_BIG=y
CONFIG_ZRAM=y
CONFIG_ZRAM_WRITEBACK=y
CONFIG_ZRAM_DEDUP=y
CONFIG_ZRAM_NON_COMPRESS=y
CONFIG_HYPERHOLD_CORE=y
CONFIG_HYPERHOLD_DEBUG_FS=y
CONFIG_HW_XRECLAIMER=y
CONFIG_ION_PREALLOC_POOL=y
# memory macros start
# hibernation
CONFIG_HONOR_SWAP_ZDATA=y
CONFIG_PROCESS_RECLAIM=y
# compression priority
CONFIG_DIRECT_SWAPPINESS=y
# protect_LRU
CONFIG_MEMCG_PROTECT_LRU=y
# CONFIG_TASK_PROTECT_LRU is not set
# CONFIG_MEMCG_FINE_GRANULARITY_PROTECT_LRU is not set
# vip pagecache
CONFIG_VIP_PAGE_CACHE=y
# print topN
CONFIG_MEMINFO_DUMP=y
CONFIG_PGTABLE_MAPPING=y
# slow path
CONFIG_SLOW_PATH_COUNT=y
# memory monitor
CONFIG_MEMORY_MONITOR=y
CONFIG_TASK_DELAY_ACCT=y
CONFIG_UNMOVABLE_ISOLATE=y
CONFIG_UNMOVABLE_ISOLATE1_SIZE_MBYTES=350
CONFIG_UNMOVABLE_ISOLATE2_SIZE_MBYTES=28
# page tracker
# CONFIG_PAGE_TRACKER is not set
# lmk dbg & lowmem dbg
CONFIG_LMK_DBG=y
CONFIG_LOWMEM_DBG=y
# memory macros end
CONFIG_BLK_DEV_LOOP_MIN_COUNT=16
CONFIG_MEDIATEK_SOLUTION=y
CONFIG_MTK_PLATFORM="mt6853"
CONFIG_ARCH_MTK_PROJECT="k6833v1_64"
CONFIG_MTK_AB_OTA_UPDATER=y
CONFIG_MTK_ENG_BUILD=y
CONFIG_MTK_GPT_SCHEME_SUPPORT=y
# CONFIG_MTK_BLOCK_TAG is not set
CONFIG_MTK_PMIC_NEW_ARCH=y
CONFIG_MTK_PMIC_COMMON=y
CONFIG_MTK_PMIC_CHIP_MT6359P=y
CONFIG_MTK_EXTERNAL_CHARGER_TYPE_DETECT=y
CONFIG_MFD_MT6360_PMU=y
CONFIG_MT6360_PMU_CHARGER=y
CONFIG_MT6360_PMU_FLED=y
CONFIG_MT6360_PMIC=y
CONFIG_MT6360_LDO=y
CONFIG_LCD_KIT_MTK=y
CONFIG_LCD_KIT_DRIVER=y
CONFIG_MTK_CPU_FREQ=y
CONFIG_MTK_PTPOD=y
CONFIG_MTK_PTPOD_GPU=y
CONFIG_MTK_STATIC_POWER=y
CONFIG_MTK_UNIFY_POWER=y
CONFIG_MTK_SLBC=y
CONFIG_MTK_THERMAL_PA_VIA_ATCMD=y
CONFIG_CUSTOM_KERNEL_IMGSENSOR="imx586_mipi_raw imx576_mipi_raw s5k3m5sx_mipi_raw imx481_mipi_raw imx519_mipi_raw imx398_mipi_raw imx350_mipi_raw s5k2l7_mipi_raw imx386_mipi_raw imx386_mipi_mono s5k2t7sp_mipi_raw imx499_mipi_raw"
CONFIG_CUSTOM_KERNEL_CAM_CAL_DRV="BRCB032GWZ_3 GT24c32a cat24c16"
CONFIG_MTK_CAMERA_ISP_RSC_SUPPORT=y
CONFIG_MTK_CAMERA_ISP_DPE_SUPPORT=y
CONFIG_MTK_CAMERA_ISP_FD_SUPPORT=y
CONFIG_MTK_CAMERA_ISP_MFB_SUPPORT=y
CONFIG_MTK_CAM_CAL=y
CONFIG_MTK_CMDQ=y
CONFIG_MTK_CMDQ_MBOX_EXT=y
CONFIG_MTK_IMGSENSOR=y
CONFIG_HUAWEI_DSM_CAMERA=y
CONFIG_MTK_SMI_EXT=y
CONFIG_CUSTOM_KERNEL_LCM="nt35695B_fhd_dsi_cmd_auo_rt5081 td4330_fhdp_dsi_cmd_auo_rt5081 ft8756_fhdp_dsi_vdo_auo_rt4801"
CONFIG_MTK_LCM_PHYSICAL_ROTATION="0"
CONFIG_LCM_HEIGHT="2300"
CONFIG_MTK_AAL_SUPPORT=y
CONFIG_MTK_CAM_SECURITY_SUPPORT=y
CONFIG_MTK_CAM_GENIEZONE_SUPPORT=y
CONFIG_MTK_CCU=y
CONFIG_MTK_SENSOR_SUPPORT=y
CONFIG_MTK_SENSOR_ARCHITECTURE="2.0"
CONFIG_CUSTOM_KERNEL_ACCELEROMETER=y
CONFIG_CUSTOM_KERNEL_ALSPS=y
CONFIG_CUSTOM_KERNEL_GYROSCOPE=y
CONFIG_CUSTOM_KERNEL_MAGNETOMETER=y
CONFIG_CUSTOM_KERNEL_BAROMETER=y
CONFIG_CUSTOM_KERNEL_GRV_SENSOR=y
CONFIG_CUSTOM_KERNEL_GMRV_SENSOR=y
CONFIG_CUSTOM_KERNEL_RV_SENSOR=y
CONFIG_CUSTOM_KERNEL_LINEARACCEL_SENSOR=y
CONFIG_CUSTOM_KERNEL_GRAVITY_SENSOR=y
CONFIG_CUSTOM_KERNEL_UNCALI_ACC_SENSOR=y
CONFIG_CUSTOM_KERNEL_UNCALI_GYRO_SENSOR=y
CONFIG_CUSTOM_KERNEL_UNCALI_MAG_SENSOR=y
CONFIG_CUSTOM_KERNEL_STEP_COUNTER=y
CONFIG_CUSTOM_KERNEL_SENSORHUB=y
CONFIG_MTK_COMBO=y
CONFIG_MTK_COMBO_BT=y
CONFIG_MTK_COMBO_CHIP_CONSYS_6833=y
CONFIG_MTK_COMBO_GPS=y
CONFIG_MTK_COMBO_WIFI=y
CONFIG_HW_NETWORK_AWARE=y
CONFIG_HUAWEI_WIFI=y
CONFIG_HW_WIFIPRO=y
CONFIG_HW_WIFIPRO_PROC=y
CONFIG_HW_CHR_TCP_SMALL_WIN_MONITOR=y
CONFIG_CHR_NETLINK_MODULE=y
CONFIG_CHR_MTK_NETLINK=y
CONFIG_HUAWEI_BASTET_MTK=y
CONFIG_MTK_DHCPV6C_WIFI=y
CONFIG_MTK_GPS_SUPPORT=y
CONFIG_MTK_GPS_EMI=y
CONFIG_MTK_FMRADIO=y
CONFIG_MTK_FM_CHIP="MT6631_FM"
CONFIG_MTK_CONNSYS_DEDICATED_LOG_PATH=y
CONFIG_MTK_MD1_SUPPORT=25
CONFIG_MTK_ECCCI_DRIVER=y
CONFIG_MTK_ECCCI_C2K=y
CONFIG_MTK_BTIF=y
CONFIG_MTK_MDDP_SUPPORT=y
CONFIG_MTK_MCIF_WIFI_SUPPORT=y
CONFIG_MTK_ENABLE_GENIEZONE=y
CONFIG_MTK_ACCDET=y
CONFIG_ACCDET_EINT_IRQ=y
CONFIG_ACCDET_SUPPORT_EINT0=y
# CONFIG_MTK_M4U is not set
CONFIG_MTK_PSEUDO_M4U=y
CONFIG_MTK_LENS=y
CONFIG_MTK_FLASHLIGHT=y
CONFIG_MTK_FLASHLIGHT_MT6360=y
CONFIG_MTK_FLASHLIGHT_PT_STRICT=y
CONFIG_MTK_FLASHLIGHT_DLPT=y
CONFIG_MTK_TINYSYS_SCP_SUPPORT=y
CONFIG_MTK_LEDS=y
CONFIG_LEDS_MTK_PWM=y
CONFIG_MTK_PWM=y
CONFIG_MTK_CHIP=y
CONFIG_MTK_IDLE_BALANCE_ENHANCEMENT=y
CONFIG_MTK_SCHED_EAS_POWER_SUPPORT=y
CONFIG_SCHED_HMP=y
CONFIG_MTK_SCHED_BOOST=y
CONFIG_MTK_SCHED_RQAVG_KS=y
CONFIG_MTK_SCHED_RQAVG_US=y
CONFIG_MTK_SCHED_CPULOAD=y
CONFIG_MTK_RT_THROTTLE_MON=y
CONFIG_USB_MTK_HDRC=y
CONFIG_MTK_MUSB_QMU_SUPPORT=y
CONFIG_MTK_MUSB_QMU_PURE_ZLP_SUPPORT=y
CONFIG_MTK_MUSB_DRV_36BIT=y
CONFIG_USB_MTK_OTG=y
CONFIG_MTK_RAM_CONSOLE=y
CONFIG_MTK_AEE_FEATURE=y
CONFIG_HONOR_KERNEL=y
CONFIG_HONOR_KERNEL_DEBUG=y
# CONFIG_USB_MU3D_DEFAULT_U2_MODE is not set
CONFIG_MTK_RTC=y
CONFIG_MTK_USB_TYPEC_U3_MUX=y
CONFIG_TCPC_MT6360=y
CONFIG_TCPC_CLASS=y
CONFIG_USB_POWER_DELIVERY=y
CONFIG_MTK_LOAD_TRACKER=y
CONFIG_MTK_CPU_CTRL_CFP=y
CONFIG_MTK_PERF_OBSERVER=y
CONFIG_MTK_RESYM=y
CONFIG_MTK_FPSGO_V3=y
CONFIG_MTK_EARA_THERMAL=y
CONFIG_MTK_GBE=y
CONFIG_MTK_PERF_TRACKER=y
#CONFIG_MTK_TASK_TURBO is not set
CONFIG_MTPROF=y
CONFIG_MTK_SCHED_MONITOR=y
CONFIG_MTK_IRQ_COUNT_TRACER=y
CONFIG_MTK_IRQ_OFF_TRACER=y
CONFIG_MTK_PREEMPT_TRACER=y
CONFIG_ANDROID_DEFAULT_SETTING=y
CONFIG_MTK_ANDROID_DEFAULT_SETTING=y
CONFIG_MTK_TIMER_TIMESYNC=y
CONFIG_MTK_FREQ_HOPPING=y
CONFIG_MTK_TINYSYS_SSPM_SUPPORT=y
CONFIG_MTK_GPU_SUPPORT=y
CONFIG_MTK_GPU_VERSION="mali valhall r25p0"
CONFIG_MTK_GPU_COMMON_DVFS_SUPPORT=y
CONFIG_MTK_GPU_SWPM_SUPPORT=y
CONFIG_MTK_VIBRATOR=y
CONFIG_MTK_SYNC=y
CONFIG_MTK_DRAM_LOG_STORE=y
CONFIG_MTK_DRAM_LOG_STORE_ADDR=0x0011DF00
CONFIG_MTK_DRAM_LOG_STORE_SIZE=0x100
CONFIG_MTK_CACHE_PARTITION_CTRL=y
CONFIG_MTK_TINYSYS_MCUPM_SUPPORT=y
CONFIG_SCSI=y
CONFIG_BLK_DEV_SD=y
CONFIG_SCSI_SCAN_ASYNC=y
CONFIG_SCSI_UFSHCD=y
CONFIG_SCSI_UFSHCD_PLATFORM=y
CONFIG_MTK_UFS_SUPPORT=y
CONFIG_UFSFEATURE=y
CONFIG_UFSHPB=y
CONFIG_UFSTW=y
CONFIG_UFSTW_IGNORE_GUARANTEE_BIT=y
CONFIG_SCSI_SKHPB=y
#config for UFS lifetime test
CONFIG_HONOR_RWLOG=y
CONFIG_SCSI_UFS_CRYPTO=y
CONFIG_BLK_DEV_DM=y
CONFIG_DM_DEBUG=y
CONFIG_DM_CRYPT=y
CONFIG_DM_DEFAULT_KEY=y
CONFIG_DM_UEVENT=y
CONFIG_DM_VERITY_FEC=y
CONFIG_IFB=y
# CONFIG_ETHERNET is not set
CONFIG_PPP_FILTER=y
CONFIG_PPP_MULTILINK=y
CONFIG_PPPOE=y
CONFIG_PPP_ASYNC=y
CONFIG_PPP_SYNC_TTY=y
CONFIG_KEYBOARD_MTK=y
CONFIG_ONEKEY_REBOOT_NORMAL_MODE=y
CONFIG_ONEKEY_REBOOT_OTHER_MODE=y
CONFIG_KPD_PWRKEY_USE_PMIC=y
# CONFIG_INPUT_MOUSE is not set
# CONFIG_INPUT_TOUCHSCREEN is not set
# CONFIG_TOUCHSCREEN_MTK_TOUCH is not set
CONFIG_INPUT_MISC=y
CONFIG_INPUT_UINPUT=y
CONFIG_HUAWEI_THP=y
CONFIG_HUAWEI_THP_NOVATECH=y
CONFIG_HUAWEI_THP_ILITEK=y
CONFIG_HUAWEI_THP_MTK=y
CONFIG_HUAWEI_HOST_TS_KIT=y
CONFIG_HUAWEI_TS_KIT_3_0=y
CONFIG_HUAWEI_DEVKIT_MTK_3_0=y
CONFIG_ILITEK_TS_KIT_3_0=y
# CONFIG_VT is not set
CONFIG_LEGACY_PTY_COUNT=16
# CONFIG_DEVMEM is not set
CONFIG_SERIAL_8250=y
CONFIG_SERIAL_8250_CONSOLE=y
CONFIG_SERIAL_8250_NR_UARTS=2
CONFIG_SERIAL_8250_RUNTIME_UARTS=2
CONFIG_SERIAL_8250_MT6577=y
CONFIG_I2C_MTK=y
CONFIG_SPI=y
CONFIG_SPI_MT65XX=y
CONFIG_SPMI=y
CONFIG_MTK_PMIF=y
CONFIG_MTK_GAUGE_VERSION=30
CONFIG_MTK_CHARGER=y
CONFIG_MTK_KERNEL_POWER_OFF_CHARGING=y
# CONFIG_HWMON is not set
CONFIG_THERMAL=y
CONFIG_THERMAL_DEFAULT_GOV_BACKWARD_COMPATIBLE=y
CONFIG_WATCHDOG=y
CONFIG_MTK_WATCHDOG_COMMON=y
CONFIG_MTK_WATCHDOG_COMMON_V2=y
CONFIG_MFD_MT6358=y
CONFIG_MT6358_MISC=y
CONFIG_MTK_MFD_SPMI_PMIC=y
CONFIG_REGULATOR=y
CONFIG_REGULATOR_MT6315=y
CONFIG_REGULATOR_MT6359P=y
CONFIG_MEDIA_SUPPORT=y
CONFIG_MEDIA_CAMERA_SUPPORT=y
CONFIG_MEDIA_CONTROLLER=y
CONFIG_VIDEO_V4L2_SUBDEV_API=y
CONFIG_V4L2_FLASH_LED_CLASS=y
CONFIG_V4L_PLATFORM_DRIVERS=y
CONFIG_V4L_MEM2MEM_DRIVERS=y
CONFIG_VIDEO_MEDIATEK_JPEG=y
CONFIG_VIDEO_MEDIATEK_VCODEC=y
CONFIG_DRM=y
CONFIG_DRM_PANEL_NT35695B_AUO_VDO=y
CONFIG_DRM_PANEL_TRULY_TD4330_VDO=y
CONFIG_DRM_PANEL_TRULY_FT8756_VDO=y
CONFIG_DRM_MEDIATEK=y
CONFIG_FB_MODE_HELPERS=y
CONFIG_FB_TILEBLITTING=y
CONFIG_BACKLIGHT_LCD_SUPPORT=y
CONFIG_BACKLIGHT_CLASS_DEVICE=y
CONFIG_LOGO=y
CONFIG_SND_HRTIMER=y
CONFIG_SND_DYNAMIC_MINORS=y
CONFIG_SND_VERBOSE_PRINTK=y
CONFIG_SND_DEBUG=y
CONFIG_SND_DEBUG_VERBOSE=y
CONFIG_SND_PCM_XRUN_DEBUG=y
CONFIG_SND_SEQUENCER=y
CONFIG_SND_SEQ_DUMMY=y
CONFIG_SND_USB_AUDIO=y
CONFIG_SND_SOC=y
CONFIG_SND_SOC_MT6833_MT6359=y
CONFIG_SND_SOC_MTK_BTCVSD=y
CONFIG_SND_SOC_RT5509=y
CONFIG_HIDRAW=y
CONFIG_HID_A4TECH=y
CONFIG_HID_APPLE=y
CONFIG_HID_BELKIN=y
CONFIG_HID_CHERRY=y
CONFIG_HID_CHICONY=y
CONFIG_HID_CYPRESS=y
CONFIG_HID_DRAGONRISE=y
CONFIG_HID_EZKEY=y
CONFIG_HID_KYE=y
CONFIG_HID_GYRATION=y
CONFIG_HID_TWINHAN=y
CONFIG_HID_KENSINGTON=y
CONFIG_HID_LOGITECH=y
CONFIG_HID_MAGICMOUSE=y
CONFIG_HID_MICROSOFT=y
CONFIG_HID_MONTEREY=y
CONFIG_HID_PANTHERLORD=y
CONFIG_HID_PETALYNX=y
CONFIG_HID_SAMSUNG=y
CONFIG_HID_SUNPLUS=y
CONFIG_HID_GREENASIA=y
CONFIG_HID_SMARTJOYPLUS=y
CONFIG_HID_TOPSEED=y
CONFIG_HID_THRUSTMASTER=y
CONFIG_HID_ZEROPLUS=y
CONFIG_HUAWEI_SOP=y
CONFIG_HUAWEI_SOP_ENG=y
CONFIG_USB_STORAGE=y
CONFIG_USB_STORAGE_DATAFAB=y
CONFIG_USB_STORAGE_FREECOM=y
CONFIG_USB_STORAGE_ISD200=y
CONFIG_USB_STORAGE_USBAT=y
CONFIG_USB_STORAGE_SDDR09=y
CONFIG_USB_STORAGE_SDDR55=y
CONFIG_USB_STORAGE_JUMPSHOT=y
CONFIG_USB_STORAGE_ALAUDA=y
CONFIG_USB_STORAGE_ONETOUCH=y
CONFIG_USB_STORAGE_KARMA=y
CONFIG_USB_STORAGE_CYPRESS_ATACB=y
CONFIG_USB_TRANCEVIBRATOR=y
CONFIG_NOP_USB_XCEIV=y
CONFIG_DUAL_ROLE_USB_INTF=y
CONFIG_USB_GADGET_VBUS_DRAW=500
CONFIG_USB_CONFIGFS_SERIAL=y
CONFIG_USB_CONFIGFS_ACM=y
CONFIG_USB_CONFIGFS_RNDIS=y
CONFIG_USB_CONFIGFS_MASS_STORAGE=y
CONFIG_USB_CONFIGFS_F_HID=y
CONFIG_MMC=y
CONFIG_MMC_BLOCK_MINORS=32
CONFIG_MMC_CRYPTO=y
CONFIG_MMC_MTK_PRO=y
CONFIG_MTK_EMMC_SUPPORT=y
CONFIG_MTK_EMMC_CACHE=y
CONFIG_MTK_EMMC_SUPPORT_OTP=y
CONFIG_MTK_EMMC_HW_CQ=y
CONFIG_NEW_LEDS=y
CONFIG_LEDS_CLASS=y
CONFIG_LEDS_CLASS_FLASH=y
CONFIG_LEDS_TRIGGERS=y
CONFIG_LEDS_TRIGGER_TIMER=y
# CONFIG_RTC_SYSTOHC is not set
CONFIG_RTC_DRV_MT6358=y
CONFIG_DMADEVICES=y
CONFIG_DMA_MTK_UART=y
CONFIG_SW_SYNC=y
CONFIG_ANDROID_INTF_ALARM_DEV=y
CONFIG_ION=y
CONFIG_MTK_ION=y
CONFIG_NANOHUB=y
CONFIG_NANOHUB_MTK_IPI=y
CONFIG_MAILBOX=y
CONFIG_MTK_CMDQ_MBOX=y
CONFIG_MTK_IOMMU_V2=y
CONFIG_MTK_IOMMU_PGTABLE_EXT=34
CONFIG_RPMSG_MTK=y
CONFIG_MTK_PMIC_WRAP=y
CONFIG_MTK_IPI=y
CONFIG_MTK_MBOX=y
CONFIG_IIO=y
CONFIG_IIO_BUFFER=y
CONFIG_IIO_KFIFO_BUF=y
CONFIG_MEDIATEK_MT6577_AUXADC=y
CONFIG_MT635X_AUXADC=y
CONFIG_PWM=y
CONFIG_PWM_MTK_DISP=y
CONFIG_EXT4_DEBUG=y
CONFIG_FS_ENCRYPTION_INLINE_CRYPT=y
#
# TEE OS
#
CONFIG_TZDRIVER=y
# CONFIG_HISI_SECBOOT_IMG is not set
# CONFIG_HISI_SECBOOT_IMG_V2 is not set
# CONFIG_ASAN_DEBUG is not set
CONFIG_CLIENT_AUTH=y
CONFIG_ANDROID_HIDL=y
CONFIG_AUTH_ENHANCE=y
CONFIG_CPU_AFF_NR=0
# CONFIG_DRM_ADAPT is not set
CONFIG_TEECD_AUTH=y
CONFIG_TEE_AUDIT=y
CONFIG_KERNEL_CLIENT=y
CONFIG_SELINUX_ADAPT=y
# CONFIG_BIG_SESSION is not set
# CONFIG_DYNAMIC_ION is not set
# CONFIG_STATIC_ION is not set
# CONFIG_RDR_MEM is not set
CONFIG_TEELOG=y
CONFIG_TEE_LOG_ACHIVE_PATH="/data/log/tee/last_teemsg"
CONFIG_TEE_KTRACE=y
# CONFIG_TEE_LOG_EXCEPTION is not set
# CONFIG_TEE_TUI is not set
# CONFIG_TEE_TUI_FP is not set
CONFIG_TA_AFFINITY=y
CONFIG_TA_AFFINITY_CPU_NUMS=8
CONFIG_RPMB_AGENT=y
CONFIG_QUOTA_NETLINK_INTERFACE=y
CONFIG_INCREMENTAL_FS=y
CONFIG_ISO9660_FS=y
CONFIG_JOLIET=y
CONFIG_ZISOFS=y
CONFIG_MSDOS_FS=y
CONFIG_VFAT_FS=y
CONFIG_TMPFS=y
CONFIG_PSTORE=y
CONFIG_PSTORE_CONSOLE=y
CONFIG_PSTORE_PMSG=y
CONFIG_PSTORE_RAM=y
CONFIG_RCC=y
CONFIG_PROC_MEMORYINFO_LITE=y
CONFIG_SPECULATIVE_PAGE_FAULT=y
# CONFIG_NETWORK_FILESYSTEMS is not set
CONFIG_NLS_CODEPAGE_437=y
CONFIG_NLS_CODEPAGE_950=y
CONFIG_NLS_ASCII=y
CONFIG_NLS_ISO8859_1=y
CONFIG_NLS_UTF8=y
CONFIG_PRINTK_TIME=y
CONFIG_DYNAMIC_DEBUG=y
CONFIG_DEBUG_INFO=y
CONFIG_FRAME_WARN=3600
CONFIG_PAGE_OWNER=y
CONFIG_DEBUG_SECTION_MISMATCH=y
CONFIG_DEBUG_PAGEALLOC=y
CONFIG_DEBUG_PAGEALLOC_ENABLE_DEFAULT=y
CONFIG_SLUB_DEBUG_ON=y
CONFIG_DEBUG_KMEMLEAK=y
CONFIG_DEBUG_KMEMLEAK_EARLY_LOG_SIZE=6400
CONFIG_DEBUG_KMEMLEAK_DEFAULT_OFF=y
CONFIG_DEBUG_VIRTUAL=y
CONFIG_PANIC_ON_OOPS=y
CONFIG_PANIC_TIMEOUT=5
CONFIG_SCHEDSTATS=y
CONFIG_SCHED_STACK_END_CHECK=y
CONFIG_PROVE_LOCKING=y
CONFIG_DEBUG_LOCKDEP=y
CONFIG_DEBUG_ATOMIC_SLEEP=y
CONFIG_RCU_CPU_STALL_TIMEOUT=15
CONFIG_RCU_TRACE=y
CONFIG_FAULT_INJECTION=y
CONFIG_MTK_SCHED_TRACERS=y
CONFIG_MTK_FTRACE_DEFAULT_ENABLE=y
CONFIG_DMA_API_DEBUG=y
CONFIG_BUG_ON_DATA_CORRUPTION=y
CONFIG_KGDB=y
CONFIG_KGDB_KDB=y
CONFIG_STATIC_USERMODEHELPER_PATH="/system_ext/bin/aee_core_forwarder"
CONFIG_HW_ROOT_SCAN_RODATA_MEASUREMENT_API=y
CONFIG_TEE_KERNEL_MEASUREMENT_API=y
CONFIG_TEE_ANTIROOT_CLIENT_ENG_DEBUG=y
CONFIG_TEE_ANTIROOT_CLIENT=y
CONFIG_SECURITYFS=y
CONFIG_SECURITY_SELINUX_BOOTPARAM=y
CONFIG_CRYPTO_TWOFISH=y
# CONFIG_CRYPTO_HW is not set
CONFIG_STORAGE_DSM_IOMT_HOST=y
CONFIG_STORAGE_DSM_IOMT_UFS_HOST=y
# config for bootfail
# CONFIG_HUAWEI_BFM is not set
# CONFIG_HW_BFMR_MTK is not set
# CONFIG_USE_BOOTFAIL_RECOVERY_SOLUTION is not set
CONFIG_BOOT_DETECTOR=y
# CONFIG_BOOT_DETECTOR_HISI is not set
# CONFIG_BOOT_DETECTOR_QCOM is not set
CONFIG_BOOT_DETECTOR_MTK=y
CONFIG_BOOT_DETECTOR_AB_UPDATER=y
# CONFIG_BOOT_DETECTOR_HONGHU is not set
CONFIG_BOOT_RECOVERY=y
CONFIG_HUAWEI_CHARGER=y
CONFIG_DIRECT_CHARGER=y
CONFIG_HW_BOOSTER=y
CONFIG_HW_PACKET_FILTER_BYPASS=y
CONFIG_HW_DPIMARK_MODULE=y
#config for common_module
CONFIG_HUAWEI_POWER_EMBEDDED_ISOLATION=y
CONFIG_HUAWEI_POWER_DEVICES_INFO=y
CONFIG_HUAWEI_POWER_THERMALZONE=y
CONFIG_HUAWEI_POWER_DEBUG=y
# for fcp
CONFIG_FCP_CHARGER=y
# config for hardware ic
CONFIG_RT9466_CHARGER=y
CONFIG_RT9471_CHARGER=y
CONFIG_LOADSWITCH=y
CONFIG_RT9748=y
CONFIG_SWITCHCAP=y
CONFIG_BQ25970=y
CONFIG_RT9759=y
CONFIG_LTC7820=y
CONFIG_SM5450=y
CONFIG_SC8545=y
CONFIG_ADAPTER_PROTOCOL=y
CONFIG_ADAPTER_PROTOCOL_FCP=y
CONFIG_ADAPTER_PROTOCOL_SCP=y
CONFIG_ADAPTER_PROTOCOL_PD=y
CONFIG_SECTION_MISMATCH_WARN_ONLY=y
CONFIG_HUAWEI_PD=y
CONFIG_HW_GADGET=y
CONFIG_HONOR_USB=y
CONFIG_USB_HW_F_ACM=y
CONFIG_USB_CONFIGFS_HW_ACM=y
CONFIG_USB_MASS_STORAGE_SUPPORT_MAC=y
# for switch
CONFIG_USB_SWITCH=y
CONFIG_SWITCH_FSA9685=y
CONFIG_SWITCH_USB_CLS=y
CONFIG_CRC8=y
CONFIG_HUAWEI_USB_SHORT_CIRCUIT_PROTECT=y
CONFIG_MT6873_USCP_ADC=y
#CONFIG_SCHARGER_V600=y
#config for hardwire monitor
CONFIG_HUAWEI_WATER_DETECT=y
CONFIG_HUAWEI_SOC_DECIMAL=y
CONFIG_HUAWEI_VBUS_MONITOR=y
CONFIG_HUAWEI_SOC_CONTROL=y
CONFIG_HUAWEI_BTB_CHECK=y
CONFIG_HUAWEI_FFC_CONTROL=y
CONFIG_HUAWEI_WATER_CHECK=y
#config for hardware channel
CONFIG_WIRED_CHANNEL_SWITCH=y
CONFIG_HUAWEI_BATTERY_INFORMATION=y
CONFIG_HUAWEI_BATTCT_SLE95250=y
CONFIG_HUAWEI_BATTERY_TYPE_IDENTIFY=y
CONFIG_HUAWEI_POWER_MESG_INTERFACE=y
CONFIG_HUAWEI_FEATURE_PRINT_PID_NAME=y
#config for huawei battery
CONFIG_HUAWEI_BATTERY_SOH=y
CONFIG_HUAWEI_BATTERY_TEMP=y
CONFIG_HUAWEI_MULTI_BTB_TEMP=y
CONFIG_HUAWEI_POWER_PROXY=y
CONFIG_HUAWEI_POWER_SUPPLY=y
CONFIG_HUAWEI_BATTERY_CORE=y
CONFIG_HUAWEI_BATTERY_FAULT=y
CONFIG_HUAWEI_BATTERY_MODEL=y
CONFIG_HUAWEI_BATTERY_UI_CAPACTIY=y
CONFIG_HUAWEI_COUL=y
CONFIG_HUAWEI_DSM=y
# fuel gauge
CONFIG_BQ27Z561_FUEL_GAUGE=y
CONFIG_RT9426_FUEL_GAUGE=y
CONFIG_FUEL_GAUGE=y
CONFIG_USB_CONFIGFS_NCM=y
CONFIG_USB_F_NCM=y
CONFIG_USB_U_ETHER=y
CONFIG_EROFS_FS=y
CONFIG_EROFS_FS_XATTR=y
# CONFIG_EROFS_FS_POSIX_ACL is not set
CONFIG_EROFS_FS_SECURITY=y
CONFIG_EROFS_FS_USE_VM_MAP_RAM=y
# CONFIG_EROFS_FAULT_INJECTION is not set
CONFIG_EROFS_FS_ZIP=y
CONFIG_EROFS_FS_CLUSTER_PAGE_LIMIT=1
# CONFIG_EROFS_FS_ZIP_NO_CACHE is not set
# CONFIG_EROFS_FS_ZIP_CACHE_UNIPOLAR is not set
CONFIG_EROFS_FS_ZIP_CACHE_BIPOLAR=y
CONFIG_EROFS_FS_HUAWEI_EXTENSION=y
# config for exfat fs
CONFIG_STAGING_EXFAT_FS=y
CONFIG_STAGING_EXFAT_DISCARD=y
# CONFIG_STAGING_EXFAT_DELAYED_SYNC is not set
CONFIG_STAGING_EXFAT_KERNEL_DEBUG=y
# CONFIG_STAGING_EXFAT_DEBUG_MSG is not set
CONFIG_STAGING_EXFAT_DEFAULT_CODEPAGE=437
CONFIG_STAGING_EXFAT_DEFAULT_IOCHARSET="utf8"
CONFIG_KSTATE=y
CONFIG_HUAWEI_DUBAI=y
CONFIG_HUAWEI_DUBAI_TASK_CPU_POWER=y
CONFIG_HUAWEI_DUBAI_BATTERY_STATS=y
CONFIG_HUAWEI_DUBAI_DDR_STATS=y
CONFIG_HUAWEI_DUBAI_VCORE_STATS=y
#config for HungTask
CONFIG_DETECT_HUNG_TASK=y
CONFIG_DETECT_HUAWEI_HUNG_TASK=y
CONFIG_DEFAULT_HUNG_TASK_TIMEOUT=120
CONFIG_BOOTPARAM_HUNG_TASK_PANIC=y
CONFIG_BOOTPARAM_HUNG_TASK_PANIC_VALUE=1
CONFIG_MTK_ZRHUNG_FEATURE=y
#config for Zerohung
CONFIG_HW_ZEROHUNG=y
CONFIG_HW_DIE_CATCH=y
#config for binder proc
CONFIG_TRACE_CLOCK=y
CONFIG_BINDER_HUAWEI_TRANSACTION_BRIEF=y
CONFIG_HANDSET_SYSRQ_RESET=y
# config for DFT
CONFIG_HW_LOGGER=y
CONFIG_LOGGER_EXTEND=y
CONFIG_LOG_EXCEPTION=y
CONFIG_HWLOG_KERNEL=y
# config for iostat
CONFIG_PROC_IO_INFO=y
# config for dmd
CONFIG_HUAWEI_DSM=y
CONFIG_HUAWEI_HW_DEV_DCT=y
CONFIG_RUNMODE_TYPE_PARSE=y
CONFIG_ANTENNA_BOARDID_ADC_MATCH=y
CONFIG_RFFE_ANTENNA=y
CONFIG_HW_WIFI=y
#os security kernel config begin
#CONFIG_INIT_STACK_ALL=y
#CONFIG_INIT_ON_ALLOC_DEFAULT_ON=y
CONFIG_HUAWEI_PROC_CHECK_ROOT=y
CONFIG_MTK_KERNEL_HARDEN_DEBUG=y
CONFIG_SYSTEM_DATA_VERIFICATION=y
CONFIG_MODULE_SIG=y
CONFIG_MODULE_SIG_FORCE=y
CONFIG_MODULE_SIG_ALL=y
# CONFIG_MODULE_SIG_SHA1 is not set
# CONFIG_MODULE_SIG_SHA224 is not set
# CONFIG_MODULE_SIG_SHA256 is not set
# CONFIG_MODULE_SIG_SHA384 is not set
CONFIG_MODULE_SIG_SHA512=y
CONFIG_MODULE_SIG_HASH="sha512"
CONFIG_MODULE_SIG_KEY="huawei_signing_key.pem"
CONFIG_HUAWEI_KASLR_DEBUGFS=y
CONFIG_SLAB_FREELIST_RANDOM=y
CONFIG_HUAWEI_FREELIST_RANDOM_DEBUGFS=y
CONFIG_CFI=y
# CONFIG_CFI_PERMISSIVE is not set
CONFIG_CFI_CLANG=y
CONFIG_CFI_CLANG_SHADOW=y
CONFIG_HUAWEI_CFI_TAG=0x0035c000
CONFIG_HUAWEI_CFI_DEBUG=y
CONFIG_HUAWEI_HIDESYMS=y
CONFIG_HUAWEI_HIDESYMS_DEBUGFS=y
CONFIG_HIDESYMS_CFI_JT=y
CONFIG_HUAWEI_CFI_TAG=0x0035c000
CONFIG_HUAWEI_CFI_DEBUG=y
CONFIG_HW_KERNEL_STP=y
CONFIG_HW_KERNEL_STP_ENG_DEBUG=y
CONFIG_HW_ROOT_SCAN=y
CONFIG_HW_ROOT_SCAN_ENG_DEBUG=y
CONFIG_HUAWEI_EIMA=y
CONFIG_HUAWEI_ENG_EIMA=y
CONFIG_HUAWEI_EIMA_ACCESS_CONTROL=y
# config for cgroup_workingset
CONFIG_HW_CGROUP_WORKINGSET=y
# binder sched
CONFIG_HW_BINDER_SCHED=y
CONFIG_HW_BINDER_FG_REQ_FIRST=y
#config for honor sched featrue
CONFIG_HW_CPULOAD_NOTI=y
CONFIG_BOOST_KILL=y
CONFIG_HW_IAWARE_THREAD_BOOST=y
#CONFIG_SLUB_DEBUG_ON is not set
CONFIG_SECURITY_SELINUX_DEVELOP=y
CONFIG_SECURITY_SELINUX_TRACE_LOG=y
CONFIG_HKIP_ATKINFO_DEBUGFS=y
CONFIG_CGROUPS=y
CONFIG_BLK_CGROUP=y
CONFIG_BLK_DEV_THROTTLING=y
CONFIG_CGROUP_IOLIMIT=y
CONFIG_BLK_WBT=y
CONFIG_BLK_WBT_SQ=y
CONFIG_BLK_WBT_MQ=y
CONFIG_BLK_DEV_HI_PRIO_FOR_FG=y
#os security kernel config end
CONFIG_HONOR_FINGERPRINT_SUPPORT=y
CONFIG_HUAWEI_SENSORS_2_0=y

CONFIG_HUAWEI_EMCOM=y
CONFIG_TCP_ARGO is not set
CONFIG_HUAWEI_XENGINE=y
# CONFIG_HUAWEI_EMCOM_CHANNEL=y
CONFIG_HW_NETWORK_MEASUREMENT=y
CONFIG_HW_SMARTCARE_FI=y
CONFIG_HUAWEI_NWEVAL=y
# CONFIG_HUAWEI_OPMP=y
CONFIG_HW_EMCOM_NSTACK=y
CONFIG_HW_NSTACK_FI=y

CONFIG_MPTCP=y
CONFIG_MPTCP_PM_ADVANCED=y
CONFIG_MPTCP_FULLMESH=y
# CONFIG_MPTCP_NDIFFPORTS is not set
# CONFIG_MPTCP_BINDER is not set
CONFIG_DEFAULT_FULLMESH=y
# CONFIG_DEFAULT_DUMMY is not set
CONFIG_DEFAULT_MPTCP_PM="fullmesh"
CONFIG_MPTCP_SCHED_ADVANCED=y
# CONFIG_MPTCP_ROUNDROBIN is not set
CONFIG_MPTCP_REDUNDANT=y
CONFIG_DEFAULT_SCHEDULER=y
# CONFIG_DEFAULT_REDUNDANT is not set
CONFIG_DEFAULT_MPTCP_SCHED="default"
CONFIG_MPTCP_HEARTBEAT=y
CONFIG_MPTCP_EPC=y
CONFIG_HW_NETWORK_QOE=y
CONFIG_STREAM_DETECT=y
CONFIG_HW_GET_EXT_SIG=y
CONFIG_HW_GET_EXT_SIG_ULDELAY=y

#config for mss auto change
CONFIG_HUAWEI_MSS_AUTO_CHANGE=y

#config for ufs vendor mode
CONFIG_HONOR_UFS_VENDOR_MODE=y

# config for storage f2fs
CONFIG_F2FS_GRADING_SSR=y
CONFIG_HONOR_F2FS_DSM=y
CONFIG_UNICODE=y
# config for cifs
CONFIG_NETWORK_FILESYSTEMS=y
# CONFIG_NFS_FS is not set
# CONFIG_NFSD is not set
# CONFIG_CEPH_FS is not set
CONFIG_CIFS=y
# CONFIG_CIFS_STATS is not set
# CONFIG_CIFS_WEAK_PW_HASH is not set
# CONFIG_CIFS_UPCALL is not set
# CONFIG_CIFS_XATTR is not set
CONFIG_CIFS_DEBUG=y
# CONFIG_CIFS_DEBUG2 is not set
# CONFIG_CIFS_DEBUG_DUMP_KEYS is not set
# CONFIG_CIFS_DFS_UPCALL is not set
# CONFIG_CIFS_SMB311 is not set

#config for tcp syn linear retry
CONFIG_HW_SYN_LINEAR_RETRY=y
CONFIG_HONOR_UFS_DSM=y
CONFIG_HW_THERMAL_SHELL=y

# dm-verity
CONFIG_DM_VERITY=y
CONFIG_MTK_SECURITY_SW_SUPPORT=y

CONFIG_CARD_TRAY_GPIO_DETECT=y

CONFIG_LOG_JANK=y
```
