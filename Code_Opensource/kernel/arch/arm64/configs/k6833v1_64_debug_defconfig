## Code_Opensource/kernel/drivers/huawei_platform/pmeminfo/Kconfig
```kconfig
menu "memory info dump"

config MEMINFO_DUMP
	bool "Memory info dump for TopN"
	default n
	help
	   Dump process info and memory info for TopN

endmenu
```

## Code_Opensource/kernel/drivers/huawei_platform/sensor2_0/hall/Kconfig
```kconfig
#
# hall sensor driver configuration
#
config HUAWEI_HALL_INPUTHUB
	bool "hall sensor ak8789 driver"
	default n
	help
		Say yes here to support for hall ak8789.
```

## Code_Opensource/kernel/drivers/huawei_platform/sensor2_0/sar/a96t356/Kconfig
```kconfig
config KERNEL_SAR_A96T356
	bool "abov a96t356 for MediaTek package"
	default n
	help
	  It support different type sensor
	  in this platform. If this option
	  is set, it will support sar sensor A96T356.
```

## Code_Opensource/kernel/drivers/hwpower/cc_hardware_ic/Kconfig
```kconfig
#
# huawei hardware ic drivers
#

source "drivers/hwpower/cc_hardware_ic/buck_boost/Kconfig"
source "drivers/hwpower/cc_hardware_ic/charge_pump/Kconfig"
source "drivers/hwpower/cc_hardware_ic/switch_capacitor/Kconfig"
source "drivers/hwpower/cc_hardware_ic/boost_5v/Kconfig"
source "drivers/hwpower/cc_hardware_ic/wireless_charge_ic/Kconfig"
source "drivers/hwpower/cc_hardware_ic/charge_adc_monitor/Kconfig"
source "drivers/hwpower/cc_hardware_ic/fuel_gauge/Kconfig"

config I2C_OPERATION_IN_COMPLETE
        bool "i2c_operation_in_complete"
        default n
        help
        Say Y here to put i2c operation in complete api.
config WIRELESS_CHARGER_IC
        bool "wireless_charge_ic"
        default n
        help
        Say Y here to enable wireless charger IC.
```

## Code_Opensource/kernel/drivers/hwpower/cc_hardware_ic/wireless_charge_ic/Kconfig
```kconfig
#
# wireless charge ic driver
#

config WIRELESS_CPS4057
	bool "wireless cps4057"
	depends on WIRELESS_CHARGER
	default n
	help
	  Say Y here to enable cps4057 driver.
	  The cps4057 is an soc for magnetic induction
	  based wireless power receiver. it is fully compliant
	  with latest WPC Qi specification of BPP and EPP
	  and also supports various proprietary fast charging
	  protocols used by major smart phone OEM.

config WIRELESS_STWLC88
	bool "wireless stwlc88"
	depends on WIRELESS_CHARGER
	default n
	help
	  Say Y here to enable stwlc88 driver.
	  The stwlc68 is an soc for magnetic induction
	  based wireless power receiver. it is fully compliant
	  with latest WPC Qi specification of BPP and EPP
	  and also supports various proprietary fast charging
	  protocols used by major smart phone OEM.

config WIRELESS_MT5735
	bool "wireless mt5735"
	depends on WIRELESS_CHARGER
	default n
	help
	  Say Y here to enable mt5735 driver.
	  The mt5735 is an soc for magnetic induction
	  based wireless power receiver. it is fully compliant
	  with latest WPC Qi specification of BPP and EPP
	  and also supports various proprietary fast charging
	  protocols used by major smart phone OEM.

config WIRELESS_CPS4035
     bool "wireless cps4035"
     depends on POWER_SUPPLY
     depends on I2C
     help
       Say Y to enable support for CPS wireless charger.
```
