#include "hihonor-audio.dtsi"
#include "hihonor-storage.dtsi"
#include "hihonor-charger.dtsi"
#include "hihonor-tp.dtsi"
#include "hihonor-camera.dtsi"
#include "hihonor-lcd.dtsi"
#include "hihonor-led.dtsi"
#include "hihonor-nfc.dtsi"
#include "hihonor-irda.dtsi"
#include "hihonor-sensor.dtsi"
#include "hihonor-fingerprint.dtsi"
#include "hihonor-wifi.dtsi"
#include "hihonor-rf.dtsi"
#include "hihonor-reserved-tee-mem.dtsi"
#include "hihonor-key.dtsi"
#include "hihonor_bastet.dtsi"
