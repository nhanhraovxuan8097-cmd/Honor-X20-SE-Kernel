BCYCAE_4445_3700mah_BT167 {
	fg_para_version = <0x01>;
	cw_image_data = /bits/ 8 <
		0x46
		0x00
		0x00
		0x00
		0x00
		0x00
		0x00
		0x00
		0xAD
		0xC3
		0xCB
		0xC4
		0xC6
		0xC5
		0x85
		0x49
		0x21
		0xDA
		0xBA
		0x80
		0x76
		0x49
		0x42
		0x32
		0x28
		0x22
		0x1C
		0x5F
		0x88
		0xDE
		0x4B
		0xD2
		0xC6
		0xCB
		0xCF
		0xD3
		0xD3
		0xD0
		0xCD
		0xC9
		0xC6
		0xC7
		0xD9
		0xB3
		0x9E
		0x93
		0x89
		0x83
		0x7C
		0x82
		0x89
		0x92
		0xA7
		0x95
		0x56
		0xB8
		0x00
		0x00
		0x57
		0x10
		0x00
		0x83
		0x56
		0x00
		0x00
		0x00
		0x64
		0x07
		0x92
		0x27
		0x00
		0x00
		0x00
		0x00
		0x00
		0x00
		0x00
		0x00
		0x00
		0x21
	>;
};