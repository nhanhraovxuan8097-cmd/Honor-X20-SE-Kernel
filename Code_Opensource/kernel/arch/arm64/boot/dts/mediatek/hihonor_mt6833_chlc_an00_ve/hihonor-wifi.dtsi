&huawei_wifi_info {
	compatible = "huawei,huawei_wifi_info";
	status = "okay";
	ini_type = "CHL5G";
	wifi_chiptype = "WIFI_MTK_6631";
	power_limit = "CHL_5G";
	antenna_types = "CHL5G";
	wifi_cfg_type = "CHL5G_";
};