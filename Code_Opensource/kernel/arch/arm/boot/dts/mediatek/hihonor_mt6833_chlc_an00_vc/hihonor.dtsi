#include "hihonor-led.dtsi"
#include "hihonor-tp.dtsi"
#include "hihonor-charger.dtsi"
#include "hihonor-fingerprint.dtsi"
#include "hihonor-wifi.dtsi"
#include "hihonor-lcd.dtsi"
#include "hihonor-gnss.dtsi"
#include "hihonor-sensor.dtsi"
#include "hihonor-storage.dtsi"
#include "hihonor_sw_thermal_node.dtsi"
#include "hihonor-audio.dtsi"
#include "hihonor-nfc.dtsi"
#include "hihonor-fm.dtsi"
#include "hihonor-camera.dtsi"
#include "hihonor-key.dtsi"
#include "hihonor-reserved-tee-mem.dtsi"
#include "hihonor_bastet.dtsi"
