BITCAE_4445_3700mah_BT167 {
	fg_para_version = <0x01>;
	cw_image_data = /bits/ 8 <
		0x46
		0x00
		0x00
		0x00
		0x00
		0x00
		0x00
		0x00
		0xAD
		0xC3
		0xC8
		0xC5
		0xC5
		0xC7
		0x85
		0x46
		0x21
		0xE1
		0xC2
		0x86
		0x78
		0x4B
		0x41
		0x34
		0x29
		0x24
		0x1D
		0x61
		0x8A
		0xDE
		0x4E
		0xD3
		0xC7
		0xCA
		0xD0
		0xD4
		0xD2
		0xD2
		0xCC
		0xCA
		0xC5
		0xC7
		0xD8
		0xB6
		0x9F
		0x92
		0x8B
		0x82
		0x7B
		0x81
		0x89
		0x91
		0xA6
		0x95
		0x57
		0xB6
		0x00
		0x00
		0x57
		0x10
		0x00
		0x83
		0x42
		0x00
		0x00
		0x00
		0x64
		0x07
		0x92
		0x16
		0x00
		0x00
		0x00
		0x00
		0x00
		0x00
		0x00
		0x00
		0x00
		0xCE
	>;
};