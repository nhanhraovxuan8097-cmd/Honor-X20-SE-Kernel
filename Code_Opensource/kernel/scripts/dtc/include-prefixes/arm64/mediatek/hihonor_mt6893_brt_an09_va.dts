/dts-v1/;
/plugin/;
#include <dt-bindings/interrupt-controller/irq.h>
#include <dt-bindings/interrupt-controller/arm-gic.h>
#include <dt-bindings/spmi/spmi.h>
#include <dt-bindings/pinctrl/mt6885-pinfunc.h>

#include "mediatek/hihonor_mt6893_brt_an09_va/hihonor.dtsi"

&rootparam {
	mtk,boardid = <4 2 0 1>;
	mtk,board_name = "BRT_AN09_VA";
	mtk,product_name = "BRT-AN09";
	hardware_version = "SH1BRTM";
};

#include <k6893v1_64/cust.dtsi>
/*End of this file, DO NOT ADD ANYTHING HERE*/
