/dts-v1/;
/plugin/;
#include <dt-bindings/interrupt-controller/irq.h>
#include <dt-bindings/interrupt-controller/arm-gic.h>
#ifndef CONFIG_FPGA_EARLY_PORTING
#include <dt-bindings/pinctrl/mt6833-pinfunc.h>
#endif
#include "mediatek/hihonor_mt6833_prdc_nx1_va/hihonor.dtsi"

&rootparam {
	mtk,boardid = <4 0 5 0>;
	mtk,board_name = "PRD_NX1_VA";
	mtk,product_name = "PRD-NX1";
	hardware_version = "HN4CHLM";
};

#include <k6833v1_64/cust.dtsi>

/*End of this file, DO NOT ADD ANYTHING HERE*/
